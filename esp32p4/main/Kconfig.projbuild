## esp32p4/main/Kconfig.projbuild
```kconfig
menu "pico-fsynth"

    config FSYNTH_SAMPLE_RATE
        int "Output sample rate (Hz)"
        default 44100

    config FSYNTH_MAX_VOICES
        int "Maximum simultaneous voices"
        range 1 248
        default 128
        help
            With the effects in PSRAM, 144 voices fit in internal RAM (the
            stream rings are about 2 KB per voice), but the CPU limits it:
            at 360 MHz with fused multiply-add, 128 sustained voices use
            about 81% of each core and 144 about 91%.

    config FSYNTH_DUAL_CORE
        bool "Render voices on both cores"
        default y

    config FSYNTH_FONT_IN_PSRAM
        bool "Copy the font from flash into PSRAM at boot"
        default n
        help
            Off: the font is read in place from flash through the cache
            (memory mapped, like XIP on the Pico), unless it reaches past
            the first 16 MB of flash, which cannot be mapped: then it is
            copied anyway. On: always copied into PSRAM at boot.

    config FSYNTH_REGION_INDEX_SIZE
        int "Font regions indexed in internal RAM"
        default 16384
        help
            Key and velocity ranges of this many regions are kept in
            internal RAM (5 bytes each), so a note-on does not read region
            records from the font. GeneralUser GS has 12618 regions.

    config FSYNTH_EFFECTS_IN_PSRAM
        bool "Put the reverb and chorus memory in PSRAM"
        default y
        help
            Moves about 70 KB of effect delay lines out of internal RAM,
            leaving room for more voices.

    config FSYNTH_FP_CONTRACT
        bool "Allow fused multiply-add in the synth core"
        default y
        help
            On the ESP32-P4 it is 13% faster (94 against 108 cycles per
            voice-sample); on the RP2350 it is slower, so the Pico build
            has it off.

    config FSYNTH_RENDER_TWO_PASS
        bool "Two-pass voice sample loop"
        default y
        help
            Interpolate a block of frames first, then filter and mix
            (FS_RENDER_TWO_PASS). Lets the P4's in-order cores overlap
            floating point work.

    config FSYNTH_I2S_DIN_PIN
        int "I2S data (DIN) GPIO"
        default 23
        help
            Defaults: Waveshare Pico-Audio stacked on the P4-Pico
            (DIN 23, BCK 22, LRCK 21).

    config FSYNTH_I2S_BCK_PIN
        int "I2S bit clock (BCK) GPIO"
        default 22

    config FSYNTH_I2S_WS_PIN
        int "I2S word clock (LRCK) GPIO"
        default 21

    config FSYNTH_I2S_MCLK_PIN
        int "I2S MCLK GPIO, -1 for none"
        default -1
        help
            PCM510x DACs make their own MCLK from BCK; leave at -1.

    config FSYNTH_USB_MIDI
        bool "USB MIDI device on the high-speed USB port"
        default y
        help
            The 4-pin V / D- / D+ / G header on the P4-Pico. Needs
            CONFIG_TINYUSB_MIDI_COUNT=1 (set in sdkconfig.defaults).

    config FSYNTH_MIDI_UART_RX_PIN
        int "MIDI in (UART RX) GPIO, -1 for none"
        default 20
        help
            31250 baud from an opto-isolated MIDI input. GPIO 20 is
            physical pin 35, not used by a stacked Pico-Audio.

endmenu
```
